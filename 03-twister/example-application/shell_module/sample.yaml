## 03-twister/example-application/shell_module/sample.yaml
```yaml
sample:
  name: Shell Sample
tests:
  sample.shell.shell_module:
    filter: CONFIG_SERIAL and dt_chosen_enabled("zephyr,shell-uart")
    tags: shell
    harness: keyboard
    min_ram: 40
    integration_platforms:
      - native_posix
      - intel_socfpga_agilex5_socdk
  sample.shell.shell_module.minimal:
    filter: CONFIG_SERIAL and dt_chosen_enabled("zephyr,shell-uart")
    tags: shell
    harness: keyboard
    extra_args: CONF_FILE="prj_minimal.conf"
    integration_platforms:
      - native_posix
  sample.shell.shell_module.robot:
    harness: robot
    harness_config:
      robot_test_path: shell_module.robot
```
